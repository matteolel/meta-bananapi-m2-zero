## conf/bblayers.conf.sample
```bitbake
# POKY_BBLAYERS_CONF_VERSION is increased each time build/conf/bblayers.conf
# changes incompatibly
POKY_BBLAYERS_CONF_VERSION = "2"

BBPATH = "${TOPDIR}"
BBFILES ?= ""

BBLAYERS ?= " \
  ${TOPDIR}/../meta \
  ${TOPDIR}/../meta-poky \
  ${TOPDIR}/../meta-yocto-bsp \
  ${TOPDIR}/../../meta-openembedded/meta-oe \
  ${TOPDIR}/../../meta-openembedded/meta-python \
  ${TOPDIR}/../../meta-openembedded/meta-webserver \
  ${TOPDIR}/../../meta-openembedded/meta-networking \
  ${TOPDIR}/../../meta-sunxi \
  ${TOPDIR}/../../meta-bananapi-m2-zero \
  "
```

## conf/layer.conf
```bitbake
# We have a conf and classes directory, add to BBPATH
BBPATH .= ":${LAYERDIR}"

# We have recipes-* directories, add to BBFILES
BBFILES += "${LAYERDIR}/recipes-*/*/*.bb \
            ${LAYERDIR}/recipes-*/*/*.bbappend"

BBFILE_COLLECTIONS += "meta-bananapi-m2-zero"
BBFILE_PATTERN_meta-bananapi-m2-zero = "^${LAYERDIR}/"
BBFILE_PRIORITY_meta-bananapi-m2-zero = "20"

LAYERDEPENDS_meta-bananapi-m2-zero = "core"
LAYERSERIES_COMPAT_meta-bananapi-m2-zero = "kirkstone"
```

## conf/local.conf.sample
```bitbake
CONF_VERSION = "2"

MACHINE = "bananapi-m2-zero"
DISTRO = "poky"

PACKAGE_CLASSES ?= "package_ipk"

EXTRA_IMAGE_FEATURES ?= "debug-tweaks package-management"
CORE_IMAGE_EXTRA_INSTALL:append = "openssh openssh-sftp openssh-sftp-server"
IMAGE_INSTALL:append = " opkg nginx python3 python3-pip htop ntp packagegroup-core-buildessential "

USER_CLASSES ?= "buildstats"

PATCHRESOLVE = "noop"

BB_DISKMON_DIRS ??= "\
    STOPTASKS,${TMPDIR},1G,100K \
    STOPTASKS,${DL_DIR},1G,100K \
    STOPTASKS,${SSTATE_DIR},1G,100K \
    STOPTASKS,/tmp,100M,100K \
    HALT,${TMPDIR},100M,1K \
    HALT,${DL_DIR},100M,1K \
    HALT,${SSTATE_DIR},100M,1K \
    HALT,/tmp,10M,1K"
```
